## blackpill-mcuboot/boards/arm/blackpill/Kconfig.defconfig
```kconfig
# Copyright (c) 2020 Kalyan Sriram
# SPDX-License-Identifier: Apache-2.0

# F401CE based Black Pill V3.0+ board board configuration

if BOARD_BLACKPILL

config BOARD
	default "blackpill"

config SPI_STM32_INTERRUPT
	default y
	depends on SPI

endif # BOARD_BLACKPILL
```
